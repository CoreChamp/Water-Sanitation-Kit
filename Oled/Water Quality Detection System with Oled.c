const float Gwater = 1.5;   //Good Quality Water Referance Value 
const float Mwater = 0.8;   //Medauim Quality Water Referance Value 

#define buzzer 4
#define red 7
#define green A3
#define blue A2

#include <SPI.h>
#include <Wire.h>
#include <Adafruit_GFX.h>
#include <Adafruit_SSD1306.h>

#define SCREEN_WIDTH 128 // OLED display width, in pixels
#define SCREEN_HEIGHT 64 // OLED display height, in pixels


#define OLED_RESET     -1 // Reset pin # (or -1 if sharing Arduino reset pin)
#define SCREEN_ADDRESS 0x3C ///< See datasheet for Address; 0x3D for 128x64, 0x3C for 128x32
Adafruit_SSD1306 display(SCREEN_WIDTH, SCREEN_HEIGHT, &Wire, OLED_RESET);

static const uint8_t  PROGMEM image_data_20190410_114707[] = {
  0x00, 0x00, 0x00, 0x00, 0x00, 0x00, 0x00, 0x00, 0x00, 0x00, 0x00, 0x00, 0x00, 0x00, 0x00, 0x00,
  0x00, 0x00, 0x00, 0x00, 0x00, 0x00, 0x00, 0x00, 0x00, 0x00, 0x00, 0x00, 0x00, 0x00, 0x00, 0x00,
  0x00, 0x00, 0x00, 0x00, 0x00, 0x00, 0x00, 0x00, 0x00, 0x00, 0x00, 0x00, 0x00, 0x00, 0x00, 0x00,
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  0x00, 0x00, 0x00, 0x00, 0x00, 0x00, 0x00, 0x00, 0x00, 0x00, 0x00, 0x00, 0x00, 0x00, 0x00, 0x00
};
void setup() {
  pinMode(buzzer, OUTPUT);
  pinMode(red,OUTPUT);
  pinMode(green,OUTPUT);
  pinMode(blue,OUTPUT);
  // initialize serial communication at 9600 bits per second:
  Serial.begin(9600);
  

  // SSD1306_SWITCHCAPVCC = generate display voltage from 3.3V internally
  if(!display.begin(SSD1306_SWITCHCAPVCC, SCREEN_ADDRESS)) {
    Serial.println(F("SSD1306 allocation failed"));
    for(;;); // Don't proceed, loop forever
  }
  delay(2000); // Pause for 2 seconds
 
  // Clear the buffer.
  display.clearDisplay();
  
  // Draw bitmap on the screen
  display.drawBitmap(0, 0, image_data_20190410_114707, 128, 64, 1);
  display.display();
  delay(2000);
  display.clearDisplay();
  display.setTextColor(WHITE);

}

// the loop routine runs over and over again forever:
void loop() {
  // read the input on analog pin 0:
  int sensorValue = analogRead(A0);
  // Convert the analog reading (which goes from 0 - 1023) to a voltage (0 - 5V):
  float voltage = sensorValue * (5.0 / 1023.0);
  // print out the value you read:
  Serial.println(voltage);


  display.clearDisplay();
  display.setCursor(10,1);
  display.setTextSize(2);
  display.print("CORECHAMP");
  delay(100);
 
    if (voltage >= Gwater) {
    Serial.println("Good Quality Water");
    digitalWrite(buzzer,LOW);
    digitalWrite(red,LOW);
    digitalWrite(green,HIGH);
    digitalWrite(blue,LOW);
    display.setCursor(40,25);
    display.setTextSize(2);
    display.print("Good");
    display.setCursor(25,50);
    display.setTextSize(1);
    display.print("Quality Water");
    delay(100);
  }  if (voltage < Gwater && voltage > Mwater) {
    Serial.println("Medium Quality Water");
    digitalWrite(buzzer,LOW);
    digitalWrite(red,LOW);
    digitalWrite(green,LOW);
    digitalWrite(blue,HIGH);
    display.setCursor(30,25);
    display.setTextSize(2);
    display.print("Medium");
    display.setCursor(25,50);
    display.setTextSize(1);
    display.print("Quality Water");
    delay(100);
  } if (voltage < Mwater) {
    Serial.println("Bad Quality Water");
    digitalWrite(buzzer,HIGH);
    digitalWrite(red,HIGH);
    digitalWrite(green,LOW);
    digitalWrite(blue,LOW);
    display.setCursor(43,25);
    display.setTextSize(2);
    display.print("Bad");
    display.setCursor(25,50);
    display.setTextSize(1);
    display.print("Quality Water");
    delay(100);
} 
display.display();
}
